

// This Autoshift behavior was extracted from the official ZMK documentation. I
// tweak its options to fit me better, but nothing in here should be credited
// to me.
//
// Also, when using this behavior, you should not use it directly. Use the
// macro function defined bellow it for a better syntax.
/ {
  behaviors {
    as: auto_shift {
      compatible = "zmk,behavior-hold-tap";
      #binding-cells = <2>;
      tapping-term-ms = <200>;
      quick-tap-ms = <200>;
      flavor = "tap-preferred";
      bindings = <&kp>, <&kp>;
    };
  };
};

// Helper macro to create an Autoshift version of a key.
#define AS(keycode) &as LS(keycode) keycode     // Autoshift Macro
