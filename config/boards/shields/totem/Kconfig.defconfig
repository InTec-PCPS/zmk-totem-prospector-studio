## config/boards/shields/totem/Kconfig.defconfig
```kconfig
# Copyright (c) 2022 The ZMK Contributors
# SPDX-License-Identifier: MIT

if SHIELD_TOTEM_DONGLE

config ZMK_KEYBOARD_NAME
    default "Totem"

config ZMK_SPLIT
    default y
    
config ZMK_SPLIT_ROLE_CENTRAL
    default y

config ZMK_SPLIT_BLE_CENTRAL_PERIPHERALS
    default 3

config ZMK_POINTING
    default y

config ZMK_USB
    default y

config ZMK_BLE
    default y

endif

if SHIELD_TOTEM_TRACKBALL

config ZMK_BLE
    default y

config ZMK_POINTING
    default y

config ZMK_SPLIT
    default y

endif

if SHIELD_TOTEM_LEFT || SHIELD_TOTEM_RIGHT

config ZMK_SPLIT
    default y

config ZMK_BLE
    default y

endif
```

## config/west.yml
```yaml
manifest:
  remotes:
    - name: zmkfirmware
      url-base: https://github.com/zmkfirmware
    - name: badjeff
      url-base: https://github.com/badjeff
    - name: cyboard
      url-base: https://github.com/Cyboard-DigitalTailor
    - name: carrefinho
      url-base: https://github.com/carrefinho
  projects:
    - name: zmk
      remote: zmkfirmware
      revision: main
      import: app/west.yml
    - name: zmk-pmw3610-driver
      remote: badjeff
      revision: main
   # - name: zmk-pmw3610-driver
   #   remote: cyboard
   #   revision: startup_optimization
    - name: prospector-zmk-module
      remote: carrefinho
      revision: main
  self:
    path: config
```
